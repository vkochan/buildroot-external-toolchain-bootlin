## Config.in
```kconfig
source "$BR2_EXTERNAL_TOOLCHAIN_BOOTLIN_PATH/toolchain/toolchain-external-bootlin-x86-i686-musl/Config.in.options"
source "$BR2_EXTERNAL_TOOLCHAIN_BOOTLIN_PATH/toolchain/toolchain-external-bootlin-x86-i686-uclibc/Config.in.options"
source "$BR2_EXTERNAL_TOOLCHAIN_BOOTLIN_PATH/toolchain/toolchain-external-bootlin-armv7-eabihf-uclibc/Config.in.options"
source "$BR2_EXTERNAL_TOOLCHAIN_BOOTLIN_PATH/toolchain/toolchain-external-bootlin-armv7-eabihf-musl/Config.in.options"
source "$BR2_EXTERNAL_TOOLCHAIN_BOOTLIN_PATH/toolchain/toolchain-external-bootlin-armv7-eabihf-glibc/Config.in.options"
```
